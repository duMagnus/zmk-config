## boards/shields/magnus_56/Kconfig.shield
```kconfig
config SHIELD_MAGNUS_56_LEFT
    def_bool $(shields_list_contains,magnus_56_left)

config SHIELD_MAGNUS_56_RIGHT
    def_bool $(shields_list_contains,magnus_56_right)
```

## boards/shields/magnus_58/Kconfig.defconfig
```kconfig
if SHIELD_MAGNUS_58_LEFT

# Name must be less than 16 characters long!
config ZMK_KEYBOARD_NAME
    default "Magnus 58"

config ZMK_SPLIT_ROLE_CENTRAL
    default y

endif

if SHIELD_MAGNUS_58_LEFT || SHIELD_MAGNUS_58_RIGHT

config ZMK_SPLIT
    default y

config ZMK_PM_SOFT_OFF
  default y

config ZMK_SLEEP
  default y

endif
```

## boards/shields/magnus_58/Kconfig.shield
```kconfig
config SHIELD_MAGNUS_58_LEFT
    def_bool $(shields_list_contains,magnus_58_left)

config SHIELD_MAGNUS_58_RIGHT
    def_bool $(shields_list_contains,magnus_58_right)
```

## boards/shields/magnus_hp_44/Kconfig.defconfig
```kconfig
if SHIELD_MAGNUS_HP_44_LEFT

# Name must be less than 16 characters long!
config ZMK_KEYBOARD_NAME
    default "Magnus HP-44"

config ZMK_SPLIT_ROLE_CENTRAL
    default y

endif

if SHIELD_MAGNUS_HP_44_LEFT || SHIELD_MAGNUS_HP_44_RIGHT

config ZMK_SPLIT
    default y

config ZMK_DISPLAY
    default y

if ZMK_DISPLAY

config I2C
    default y

config SSD1306
    default y

# LVGL features your portrait renderer needs
config LV_USE_CANVAS
    default y

config LV_USE_IMG
    default y

# Font for text drawing
config LV_FONT_MONTSERRAT_12
    default y

# Give LVGL enough heap for canvas operations
config LV_Z_MEM_POOL_SIZE
    default 4096

config LV_Z_VDB_SIZE
  default 100

config LV_Z_BITS_PER_PIXEL
  default 1

choice ZMK_DISPLAY_WORK_QUEUE
  default ZMK_DISPLAY_WORK_QUEUE_DEDICATED
endchoice

choice ZMK_DISPLAY_STATUS_SCREEN
  default ZMK_DISPLAY_STATUS_SCREEN_CUSTOM
endchoice

config LV_OBJ_LABEL
    default y

config LV_FONT_MONTSERRAT_12
    default y

config LV_USE_THEME_MONO
    default y

endif # ZMK_DISPLAY

endif
```

## boards/shields/magnus_hp_44/Kconfig.shield
```kconfig
config SHIELD_MAGNUS_HP_44_LEFT
    def_bool $(shields_list_contains,magnus_hp_44_left)

config SHIELD_MAGNUS_HP_44_RIGHT
    def_bool $(shields_list_contains,magnus_hp_44_right)
```

## boards/shields/magnus_hp_44/widgets/Kconfig
```kconfig
# Ensure LVGL has the primitives needed by our custom status screen.

if ZMK_DISPLAY && ZMK_DISPLAY_STATUS_SCREEN_CUSTOM

config MAGNUS_HP_44_CUSTOM_SCREEN_LVGL_REQUIREMENTS
    bool
    default y
    # Needed for lv_label_create() and for most text-based widgets
    select LV_OBJ_LABEL
    # Recommended for monochrome OLED
    imply LV_USE_THEME_MONO

    # Make sure at least one font exists in minimal LVGL configs
    # (Montserrat 12 is a good default for 128x32)
    select LV_FONT_MONTSERRAT_12

endif
```

## boards/shields/magnus_lp_44/Kconfig.defconfig
```kconfig
if SHIELD_MAGNUS_LP_44_LEFT

# Name must be less than 16 characters long!
config ZMK_KEYBOARD_NAME
    default "Magnus LP-44"

config ZMK_SPLIT_ROLE_CENTRAL
    default y

endif

if SHIELD_MAGNUS_LP_44_LEFT || SHIELD_MAGNUS_LP_44_RIGHT

config ZMK_SPLIT
    default y

endif
```

## boards/shields/magnus_lp_44/Kconfig.shield
```kconfig
config SHIELD_MAGNUS_LP_44_LEFT
    def_bool $(shields_list_contains,magnus_lp_44_left)

config SHIELD_MAGNUS_LP_44_RIGHT
    def_bool $(shields_list_contains,magnus_lp_44_right)
```
